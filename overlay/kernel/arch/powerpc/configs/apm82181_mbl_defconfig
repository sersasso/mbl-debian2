## overlay/kernel/arch/powerpc/configs/apm82181_mbl_defconfig
```kconfig
# apm82181_mbl_defconfig — CORRETTO per WD MyBook Live (APM82181)
# CPU / SoC
CONFIG_PPC32=y
CONFIG_44x=y
CONFIG_464_CPU=y
CONFIG_APM821xx=y
CONFIG_CPU_BIG_ENDIAN=y
CONFIG_MMU=y
CONFIG_NOT_COHERENT_CACHE=y
CONFIG_NR_CPUS=1

# Memoria / paging
CONFIG_PPC_4K_PAGES=y
CONFIG_FLATMEM=y
CONFIG_HIGHMEM=n

# Dispositivi / devtmpfs
CONFIG_DEVTMPFS=y
CONFIG_DEVTMPFS_MOUNT=y

# Boot args (usati quelli del bootloader)
CONFIG_CMDLINE="console=ttyS0,115200"
CONFIG_CMDLINE_FROM_BOOTLOADER=y
CONFIG_BLK_DEV_INITRD=y

# Console seriale su 8250 con OpenFirmware (OF)
CONFIG_TTY=y
CONFIG_VT=y
CONFIG_VT_CONSOLE=y
CONFIG_SERIAL_8250=y
CONFIG_SERIAL_8250_CONSOLE=y
CONFIG_SERIAL_8250_OF=y
CONFIG_SERIAL_OF_PLATFORM=y
CONFIG_EARLY_PRINTK=y
CONFIG_PPC_EARLY_DEBUG=y
CONFIG_PPC_EARLY_DEBUG_44x=y

# Storage / SATA DesignWare 460EX (APM82181)
CONFIG_BLOCK=y
CONFIG_ATA=y
# A seconda della versione del kernel, il simbolo può essere SATA_DWC_OLD o SATA_DWC
CONFIG_SATA_DWC_OLD=y
CONFIG_SCSI=y
CONFIG_BLK_DEV_SD=y

# Filesystem root
CONFIG_EXT4_FS=y
CONFIG_EXT4_FS_POSIX_ACL=y
CONFIG_EXT4_FS_SECURITY=y
CONFIG_MSDOS_PARTITION=y
CONFIG_EFI_PARTITION=y
CONFIG_CRC32C_GENERIC=y

# Rete (IBM EMAC ppc_4xx)
CONFIG_NET=y
CONFIG_INET=y
CONFIG_IPV6=n
CONFIG_IBM_EMAC=y
CONFIG_MII=y
CONFIG_FIXED_PHY=y

# Crypto utili
CONFIG_CRYPTO=y
CONFIG_CRYPTO_AES=y
CONFIG_CRYPTO_SHA256=y
CONFIG_CRYPTO_SHA512=y
CONFIG_CRYPTO_CRC32C=y

# Moduli
CONFIG_MODULES=n
CONFIG_MODULE_UNLOAD=y
```
